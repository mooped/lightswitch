## main/Kconfig.projbuild
```kconfig
menu "Example Configuration"

config WIFI_SSID
    string "WiFi SSID"
	default "myssid"
	help
		SSID (network name) for the example to connect to.

config WIFI_PASSWORD
    string "WiFi Password"
	default "myssid"
	help
		WiFi password (WPA or WPA2) for the example to use.

		Can be left blank if the network has no security set.

config WEB_SERVER
  string "Websocket Server"
  default "192.168.0.8"
  help
    Websocket server address

config WEB_PORT
  int "Websocket port number"
  default 8181
  help
    Websocket server port number

config WEB_URL
  string "Websocket URL"
  default "/lighting"
  help
    Websocket server URL

endmenu
```
